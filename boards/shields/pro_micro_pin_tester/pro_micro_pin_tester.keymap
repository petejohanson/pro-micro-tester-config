/*
 * Copyright (c) 2020 Pete Johanson, Richard Jones
 *
 * SPDX-License-Identifier: MIT
 */

#include <behaviors.dtsi>
#include <dt-bindings/zmk/keys.h>

/ {
    keymap {
        compatible = "zmk,keymap";
        
        default_layer {
            bindings = <
	    &kp A
	    &kp B
	    &kp C      &kp D
	    &kp E      &kp F
	    &kp G      &kp H
	    &kp I      &kp J
	    &kp K      &kp L
	    &kp M      &kp N
	    &kp O      &kp P
	    &kp Q      &kp R
	    >;
        };
    };
};


