/*
 * Copyright (c) 2021 Pete Johanson
 *
 * SPDX-License-Identifier: MIT
 */

#include <dt-bindings/zmk/matrix_transform.h>

/ {
	chosen {
		zmk,kscan = &kscan0;
	};

	kscan0: kscan {
		compatible = "zmk,kscan-gpio-direct";
		label = "KSCAN";

		input-gpios
			= <&pro_micro_d 1 (GPIO_ACTIVE_LOW | GPIO_PULL_UP)>
			, <&pro_micro_d 0 (GPIO_ACTIVE_LOW | GPIO_PULL_UP)>
			, <&pro_micro_d 2 (GPIO_ACTIVE_LOW | GPIO_PULL_UP)>
			, <&pro_micro_d 3 (GPIO_ACTIVE_LOW | GPIO_PULL_UP)>
			, <&pro_micro_d 4 (GPIO_ACTIVE_LOW | GPIO_PULL_UP)>
			, <&pro_micro_d 5 (GPIO_ACTIVE_LOW | GPIO_PULL_UP)>
			, <&pro_micro_d 6 (GPIO_ACTIVE_LOW | GPIO_PULL_UP)>
			, <&pro_micro_d 7 (GPIO_ACTIVE_LOW | GPIO_PULL_UP)>
			, <&pro_micro_d 8 (GPIO_ACTIVE_LOW | GPIO_PULL_UP)>
			, <&pro_micro_d 9 (GPIO_ACTIVE_LOW | GPIO_PULL_UP)>
			, <&pro_micro_d 10 (GPIO_ACTIVE_LOW | GPIO_PULL_UP)>
			, <&pro_micro_d 16 (GPIO_ACTIVE_LOW | GPIO_PULL_UP)>
			, <&pro_micro_d 14 (GPIO_ACTIVE_LOW | GPIO_PULL_UP)>
			, <&pro_micro_d 15 (GPIO_ACTIVE_LOW | GPIO_PULL_UP)>
			, <&pro_micro_d 18 (GPIO_ACTIVE_LOW | GPIO_PULL_UP)>
			, <&pro_micro_d 19 (GPIO_ACTIVE_LOW | GPIO_PULL_UP)>
			, <&pro_micro_d 20 (GPIO_ACTIVE_LOW | GPIO_PULL_UP)>
			, <&pro_micro_d 21 (GPIO_ACTIVE_LOW | GPIO_PULL_UP)>
			;
	};
};
